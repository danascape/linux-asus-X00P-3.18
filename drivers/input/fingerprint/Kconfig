## drivers/input/fingerprint/Kconfig
```kconfig
#
# Touchscreen driver configuration
#

menuconfig INPUT_FINGERPRINT
	bool "Fingerprint"
	help
	  Say Y here, and a list of supported fingerprint will be displayed.
	  This option doesn't affect the kernel.

	  If unsure, say Y.

if INPUT_FINGERPRINT

source "drivers/input/fingerprint/asus/Kconfig"

endif
```

## drivers/input/fingerprint/asus/Kconfig
```kconfig
if MACH_ASUS

source "drivers/input/fingerprint/asus/X00H/Kconfig"
source "drivers/input/fingerprint/asus/X00I/Kconfig"
source "drivers/input/fingerprint/asus/X00P/Kconfig"

endif
```

## drivers/input/fingerprint/asus/X00H/Kconfig
```kconfig
if MACH_ASUS_X00H

source "drivers/input/fingerprint/asus/X00H/cdfinger_fp/Kconfig"
source "drivers/input/fingerprint/asus/X00H/common/Kconfig"
source "drivers/input/fingerprint/asus/X00H/goodix_fp/Kconfig"

endif
```

## drivers/input/fingerprint/asus/X00H/common/Kconfig
```kconfig
config COMMON_FINGERPRINT
	bool "COMMON_FP for Qualcomm package"
	help
	  Say Y here if you have a common fingerprint.

          If unsure, say N.
```

## drivers/input/fingerprint/asus/X00I/Kconfig
```kconfig
if MACH_ASUS_X00I

source "drivers/input/fingerprint/asus/X00I/focaltech/Kconfig"
source "drivers/input/fingerprint/asus/X00I/goodix_fp/Kconfig"

endif
```

## drivers/input/fingerprint/asus/X00I/focaltech/Kconfig
```kconfig
config FINGERPRINT_FOCALTECH_FT9338
	bool "FINGERPRINT_FOCALTECH_FT9338 for Qualcomm package"
	help
	  Say Y here if you have a focaltech fingerprint.

          If unsure, say N.
```

## drivers/input/fingerprint/asus/X00I/goodix_fp/Kconfig
```kconfig
config GOODIX_FP
	bool "GOODIX_FP for Qualcomm package"
	help
	  Say Y here if you have a goodix fingerprint.

          If unsure, say N.
```

## drivers/input/fingerprint/asus/X00P/Kconfig
```kconfig
if MACH_ASUS_X00P

source "drivers/input/fingerprint/asus/X00P/leadcore/Kconfig"
source "drivers/input/fingerprint/asus/X00P/microarray/Kconfig"
source "drivers/input/fingerprint/asus/X00P/sunwave/Kconfig"

endif
```

## drivers/input/touchscreen/asus/Kconfig
```kconfig
if MACH_ASUS

source "drivers/input/touchscreen/asus/X00H/Kconfig"
source "drivers/input/touchscreen/asus/X00I/Kconfig"
source "drivers/input/touchscreen/asus/X00P/Kconfig"
source "drivers/input/touchscreen/asus/X00R/Kconfig"

endif
```

## drivers/input/touchscreen/asus/X00H/Kconfig
```kconfig
if MACH_ASUS_X00H

source "drivers/input/touchscreen/asus/X00H/ft5436/Kconfig"
source "drivers/input/touchscreen/asus/X00H/gt9xx/Kconfig"
source "drivers/input/touchscreen/asus/X00H/hx852xes/Kconfig"

endif
```

## drivers/input/touchscreen/asus/X00H/hx852xes/Kconfig
```kconfig
config TOUCHSCREEN_HIMAX_HX852xES
	bool "Himax touchpanel"
	depends on I2C
	help
	  Say Y here if you have a Himax touchscreen.
	  If unsure, say N.

config TOUCHSCREEN_HIMAX_I2C
        tristate "HIMAX HX852xES serious i2c touchscreen"
		depends on TOUCHSCREEN_HIMAX_HX852xES
		help
		This enables support for HIMAX HX852xES over I2C based touchscreens.

config TOUCHSCREEN_HIMAX_ITO_TEST
        tristate "HIMAX HX852xES ITO TEST"
		depends on TOUCHSCREEN_HIMAX_HX852xES
		help
		This enables support for HIMAX HX852xES ito test.

config TOUCHSCREEN_HIMAX_DEBUG
        tristate "HIMAX debug function"
		depends on TOUCHSCREEN_HIMAX_I2C
		help
		This enables support for HIMAX debug function.

config HMX_DB
	tristate "HIMAX driver test over Dragon Board"
	depends on TOUCHSCREEN_HIMAX_I2C
	help
	  This enables support for HIMAX driver test over Dragon Board.
```

## drivers/input/touchscreen/asus/X00I/Kconfig
```kconfig
if MACH_ASUS_X00I

source "drivers/input/touchscreen/asus/X00I/ft5436/Kconfig"
source "drivers/input/touchscreen/asus/X00I/gt9xx/Kconfig"

endif
```

## drivers/input/touchscreen/asus/X00I/ft5436/Kconfig
```kconfig
#
# Focaltech Touchscreen driver configuration
#

config TOUCHSCREEN_FT5436
	bool "Goodix touchpanel FT5436 series"
	depends on I2C
	help
	  Say Y here if you have a FocalTech FT54xx touchscreen.
	  Gt915L controllers are multi touch controllers which can
	  report 5 touches at a time.

          If unsure, say N.

config TOUCHSCREEN_FTS
        bool "Focaltech Touchscreen"
		depends on I2C
		default y
		help
		  Say Y here if you have Focaltech touch panel.
		  If unsure, say N.

config TOUCHSCREEN_FTS_DIRECTORY
    string "Focaltech ts directory name"
    default "focaltech_touch"
    depends on TOUCHSCREEN_FTS
    
```

## drivers/input/touchscreen/asus/X00P/Kconfig
```kconfig
if MACH_ASUS_X00P

source "drivers/input/touchscreen/asus/X00P/ft5346i/Kconfig"
source "drivers/input/touchscreen/asus/X00P/gt917d/Kconfig"
source "drivers/input/touchscreen/asus/X00P/HX852xES/Kconfig"

endif
```

## drivers/input/touchscreen/asus/X00R/HX852xES_A306/Kconfig
```kconfig
#
# Himax Touchscreen driver configuration
#

config TOUCHSCREEN_HIMAX_HX83102_A306
	bool "Himax touchpanel HX83102"
	depends on I2C
	help
	  Say Y here if you have a Himax HX83102 touchscreen.
	  HIMAX controllers are multi touch controllers which can
	  report 10 touches at a time.
	  If unsure, say N.

config TOUCHSCREEN_HX852XES_A306
        bool "himax Touchscreen"
		default n
		help
		  Say Y here if you have Focaltech touch panel.
		  If unsure, say N.
          
config TOUCHSCREEN_HIMAX_I2C
        tristate "HIMAX chipset i2c touchscreen"
        default y
		help
		This enables support for HIMAX CHIPSET over I2C based touchscreens.

config TOUCHSCREEN_HIMAX_DEBUG
        tristate "HIMAX debug function"
		depends on TOUCHSCREEN_HIMAX_I2C
		help
		This enables support for HIMAX debug function.

config TOUCHSCREEN_HIMAX_ITO_TEST
	tristate "HIMAX driver test over Dragon Board"
	depends on TOUCHSCREEN_HIMAX_I2C
	help
	  This enables support for HIMAX driver test over Dragon Board.

config HMX_DB
	tristate "HIMAX driver test over Dragon Board"
	depends on TOUCHSCREEN_HIMAX_I2C
	help
	  This enables support for HIMAX driver test over Dragon Board.
```

## drivers/input/touchscreen/asus/X00R/Kconfig
```kconfig
if MACH_ASUS_X00R

source "drivers/input/touchscreen/asus/X00R/ft5346i/Kconfig"
source "drivers/input/touchscreen/asus/X00R/gt917d/Kconfig"
source "drivers/input/touchscreen/asus/X00R/hx83102_A306/Kconfig"
source "drivers/input/touchscreen/asus/X00R/HX852xES_A306/Kconfig"
source "drivers/input/touchscreen/asus/X00R/Mastar_TP/Kconfig"

endif
```

## drivers/input/touchscreen/asus/X00R/Mastar_TP/Kconfig
```kconfig
#
# MASTAR Touchscreen driver configuration
#

config TOUCHSCREEN_MASTAR_A306
	bool "Mastar TP Msg2836"
	depends on I2C
	help
	  Say Y here if you have a Msg2836 touchscreen.
	  MASTAR controllers are multi touch controllers which can
	  report 10 touches at a time.
	  If unsure, say N.

# zhaopengfei@wind-mobi.com 20180713 begin

config TOUCHSCREEN_MSG2836
        tristate "MSG2836 chipset touchscreen"
		depends on I2C
		help
		This enables support for MSG2836 CHIPSET over I2C based touchscreens.
```

## drivers/input/touchscreen/asus/X00R/hx83102_A306/Kconfig
```kconfig
#
# Himax Touchscreen driver configuration
#

# wangbing@wind-mobi.com 20180316 begin

config TOUCHSCREEN_HIMAX_HX83102_A306
	bool "Himax touchpanel HX83102"
	depends on I2C
	help
	  Say Y here if you have a Himax HX83102 touchscreen.
	  HIMAX controllers are multi touch controllers which can
	  report 10 touches at a time.
	  If unsure, say N.

config TOUCHSCREEN_HIMAX_I2C
        tristate "HIMAX chipset i2c touchscreen"
		depends on TOUCHSCREEN_HIMAX_CHIPSET
		help
		This enables support for HIMAX CHIPSET over I2C based touchscreens.

config TOUCHSCREEN_HIMAX_DEBUG
        tristate "HIMAX debug function"
		depends on TOUCHSCREEN_HIMAX_I2C
		help
		This enables support for HIMAX debug function.

config TOUCHSCREEN_HIMAX_ITO_TEST
	tristate "HIMAX driver test over Dragon Board"
	depends on TOUCHSCREEN_HIMAX_I2C
	help
	  This enables support for HIMAX driver test over Dragon Board.

config HMX_DB
	tristate "HIMAX driver test over Dragon Board"
	depends on TOUCHSCREEN_HIMAX_I2C
	help
	  This enables support for HIMAX driver test over Dragon Board.

# wangbing@wind-mobi.com 20180316 end
```

## drivers/misc/fingerprint/Kconfig
```kconfig
source "drivers/misc/fingerprint/leadcore/Kconfig"
source "drivers/misc/fingerprint/microarray/Kconfig"
source "drivers/misc/fingerprint/sunwave/Kconfig"
```

## drivers/platform/asus/Kconfig
```kconfig
# Asus X00P configuration options

config MACH_ASUS_X00P
	bool "Asus X00P"
	depends on ARCH_MSM8937
	help
	  Support for Asus X00P
```
