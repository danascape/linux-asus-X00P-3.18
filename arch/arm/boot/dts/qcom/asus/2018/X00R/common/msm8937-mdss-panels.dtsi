/*
 * Copyright (c) 2015-2018, The Linux Foundation. All rights reserved.
 *
 * This program is free software; you can redistribute it and/or modify
 * it under the terms of the GNU General Public License version 2 and
 * only version 2 as published by the Free Software Foundation.
 *
 * This program is distributed in the hope that it will be useful,
 * but WITHOUT ANY WARRANTY; without even the implied warranty of
 * MERCHANTABILITY or FITNESS FOR A PARTICULAR PURPOSE.  See the
 * GNU General Public License for more details.
 */

&mdss_mdp {
	#include "display/dsi-panel-ili9881c-cpt-video.dtsi"
	#include "display/dsi-panel-ili9881c-hsd-video.dtsi"
	#include "display/dsi-panel-st7703_co55swr8-video.dtsi"
	#include "display/dsi-panel-st7703_boe55-video.dtsi"
	#include "display/dsi-panel-st7703_easyquick-video.dtsi"
	#include "display/dsi-panel-st7703_boe66-video.dtsi"
	#include "display/dsi-panel-st7703_boe77-video.dtsi"
	#include "display/dsi-panel-ili9881p-panda5.dtsi"
	#include "display/dsi-hsd-HX83102-B-720p-video.dtsi"
};
