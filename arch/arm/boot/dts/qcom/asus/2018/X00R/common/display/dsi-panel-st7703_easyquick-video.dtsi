/*
 * Copyright (c) 2015-2018, The Linux Foundation. All rights reserved.
 *
 * This program is free software; you can redistribute it and/or modify
 * it under the terms of the GNU General Public License version 2 and
 * only version 2 as published by the Free Software Foundation.
 *
 * This program is distributed in the hope that it will be useful,
 * but WITHOUT ANY WARRANTY; without even the implied warranty of
 * MERCHANTABILITY or FITNESS FOR A PARTICULAR PURPOSE.  See the
 * GNU General Public License for more details.
 */

/*---------------------------------------------------------------------------
 * This file is autogenerated file using gcdb parser. Please do not edit it.
 * Update input XML file to add a new entry or update variable in this file
 * VERSION = "1.0"
 *---------------------------------------------------------------------------*/

dsi_easyquick_st7703_720p_video: qcom,dsi_easyquick_st7703_720p_video {
	qcom,mdss-dsi-panel-name = "dsi_easyquick_st7703_720p_video panel";
	qcom,mdss-dsi-panel-controller = <&mdss_dsi0>;
	qcom,mdss-dsi-panel-type = "dsi_video_mode";
	qcom,mdss-dsi-panel-destination = "display_1"; //
	qcom,mdss-dsi-panel-framerate = <60>;
	qcom,mdss-dsi-virtual-channel-id = <0>;  //
	qcom,mdss-dsi-stream = <0>;	//
	qcom,mdss-dsi-panel-width = <720>;
	qcom,mdss-dsi-panel-height = <1440>;
	qcom,mdss-dsi-h-front-porch = <60>;
	qcom,mdss-dsi-h-back-porch = <62>;  //
	qcom,mdss-dsi-h-pulse-width = <20>; //horizontal_sync_active
	qcom,mdss-dsi-h-sync-skew = <0>;   ////
	qcom,mdss-dsi-v-back-porch = <10>;
	qcom,mdss-dsi-v-front-porch = <17>;
	qcom,mdss-dsi-v-pulse-width = <3>; ////
	qcom,mdss-dsi-h-left-border = <0>; //
	qcom,mdss-dsi-h-right-border = <0>;//
	qcom,mdss-dsi-v-top-border = <0>; //
	qcom,mdss-dsi-v-bottom-border = <0>; //
	qcom,mdss-dsi-bpp = <24>; //
	qcom,mdss-dsi-color-order = "rgb_swap_rgb";
	qcom,mdss-dsi-underflow-color = <0xff>; //
	qcom,mdss-dsi-border-color = <0>; //
	qcom,mdss-dsi-on-command = [39 01 00 00 00 00 04 B9 F1 12 83 
		39 01 00 00 00 00 1c BA 33 83 05 F9 0e 0e 20 00 00 00 00 00 00 00 44 25 00 91 0a 00 00 02 4F 01 03 02 37 //harvey_luo@forcelead.com.tw 20180308 change for esd
		39 01 00 00 00 00 02 B8 75  
		39 01 00 00 00 00 04 BF 02 10 00 
		39 01 00 00 00 00 0b B3 07 0B 1E 1E 03 FF 00 00 00 00 
		39 01 00 00 00 00 0a C0 73 73 50 50 C0 C0 08 70 00 
		39 01 00 00 00 00 02 BC 46
		39 01 00 00 00 00 02 CB 02 			
		39 01 00 00 00 00 02 CC 0B 
		39 01 00 00 00 00 02 B4 80 
		39 01 00 00 00 00 04 B2 F0 12 F0 
		39 01 00 00 00 00 0f E3 07 07 0B 0B 10 10 00 00 00 00 FF 00 C0 17 
		39 01 00 00 00 00 0d C1 54 00 1E 1E 77 C1 FF FF EE EE EE EE 
		39 01 00 00 00 00 06 C6 16 40 CF FF 00 		//harvey_luo@forcelead.com.tw 20180509 add for esd
		39 01 00 00 00 00 03 B5 09 09 
		39 01 00 00 00 00 03 B6 BB BB 
		39 01 00 00 00 00 40 E9 82 10 05 05 A1 08 F0 12 31 23 37 82 08 F0 37 00 00 81 00 00 00 00 00 81 00 00 00 00 F8 AB 02 46 08 88 88 84 88 88 88 F8 AB 13 57 18 88 88 85 88 88 88 00 00 00 00 00 00 00 00 00 00 00 00 00 
		39 01 00 00 00 00 3e EA 0B 12 00 00 00 3D 00 00 00 00 00 00 8F AB 75 31 58 88 88 81 88 88 88 8F AB 64 20 48 88 88 80 88 88 88 23 10 00 01 20 00 00 00 00 00 00 00 00 00 00 00 00 00 00 00 30 08 E0 00 00 00 00 //harvey_luo@forcelead.com.tw 20180716
		39 01 00 00 00 00 23 E0 00 06 0B 24 2B 3F 39 33 05 0A 0C 10 11 0F 12 16 1C 00 06 0B 24 2B 3F 39 33 05 0A 0C 10 11 0F 12 16 1C
		05 01 00 00 78 00 02 11 00
		05 01 00 00 14 00 02 29 00];

	qcom,mdss-dsi-off-command = [05 01 00 00 32 00 02 28 00
				05 01 00 00 78 00 02 10 00];
	qcom,mdss-dsi-on-command-state = "dsi_lp_mode"; 
	qcom,mdss-dsi-off-command-state = "dsi_hs_mode";//harvey_luo@forcelead.com.tw 20180308 change for esd
	qcom,mdss-dsi-h-sync-pulse = <1>;
	qcom,mdss-dsi-traffic-mode = "burst_mode";
	qcom,mdss-dsi-lane-map = "lane_map_0123";
	qcom,mdss-dsi-bllp-eof-power-mode;
	qcom,mdss-dsi-bllp-power-mode;
	qcom,mdss-dsi-lane-0-state;
	qcom,mdss-dsi-lane-1-state;
	qcom,mdss-dsi-lane-2-state;
	qcom,mdss-dsi-lane-3-state;
	qcom,mdss-dsi-panel-timings = [87 1C 12 00 42 44 18 20 17 03 04 00];
	qcom,mdss-dsi-t-clk-post = <0x04>;
	qcom,mdss-dsi-t-clk-pre = <0x1B>;
	qcom,mdss-dsi-bl-min-level = <1>;
	qcom,mdss-dsi-bl-max-level = <4095>;
	//harvey_luo@forcelead.com.tw 20180308 add for esd begin 
	qcom,esd-check-enabled;
	//qcom,mdss-dsi-hfp-power-mode;
	//qcom,mdss-dsi-hbp-power-mode;
	//qcom,mdss-dsi-hsa-power-mode;
	qcom,mdss-dsi-panel-status-command = [14 01 00 01 05 00 01 68
	06 01 00 01 05 00 01 09
	14 01 00 01 05 00 01 CC
	14 01 00 01 05 00 01 AF
	];
	qcom,mdss-dsi-panel-status-command-state = "dsi_lp_mode";
	qcom,mdss-dsi-panel-status-check-mode = "reg_read";
	qcom,mdss-dsi-panel-status-read-length = <1 3 1 1>;
	qcom,mdss-dsi-panel-max-error-count = <2>;
	qcom,mdss-dsi-panel-status-value = <0xC0> , <0x80 0x73 0x04>, <0x0B>,<0xFD>;	
	//harvey_luo@forcelead.com.tw 20180308 add for esd end
	qcom,mdss-dsi-dma-trigger = "trigger_sw";
	qcom,mdss-dsi-mdp-trigger = "none";
	qcom,mdss-dsi-bl-pmic-control-type = "bl_ctrl_wled";
	qcom,mdss-dsi-reset-sequence = <1 20>, <0 10>, <1 20>;
	wind,mdss-dsi-power-on-sequence-type = <1>;
};
