/*
 * Copyright (c) 2015-2018, The Linux Foundation. All rights reserved.
 *
 * This program is free software; you can redistribute it and/or modify
 * it under the terms of the GNU General Public License version 2 and
 * only version 2 as published by the Free Software Foundation.
 *
 * This program is distributed in the hope that it will be useful,
 * but WITHOUT ANY WARRANTY; without even the implied warranty of
 * MERCHANTABILITY or FITNESS FOR A PARTICULAR PURPOSE.  See the
 * GNU General Public License for more details.
 */

dsi_ili9881c_fhd_vid: qcom,mdss_dsi_ili9881c_fhd_video_dj {
	qcom,mdss-dsi-panel-name = "ili9881c fhd video mode dsi panel";
	qcom,mdss-dsi-panel-controller = <&mdss_dsi0>;
	qcom,mdss-dsi-panel-type = "dsi_video_mode";
	qcom,mdss-dsi-panel-framerate = <60>;
	qcom,mdss-dsi-virtual-channel-id = <0>;
	qcom,mdss-dsi-stream = <0>;
	qcom,mdss-dsi-panel-width = <720>;
	qcom,mdss-dsi-panel-height = <1280>;

	qcom,mdss-pan-physical-width-dimension = <65>;
	qcom,mdss-pan-physical-height-dimension = <115>;

	qcom,mdss-dsi-h-front-porch = <100>;
	qcom,mdss-dsi-h-back-porch = <100>;
	qcom,mdss-dsi-h-pulse-width = <40>;
	qcom,mdss-dsi-h-sync-skew = <0>;
	qcom,mdss-dsi-v-back-porch = <18>;
	qcom,mdss-dsi-v-front-porch = <20>;
	qcom,mdss-dsi-v-pulse-width = <8>;
	qcom,mdss-dsi-h-left-border = <0>;
	qcom,mdss-dsi-h-right-border = <0>;
	qcom,mdss-dsi-v-top-border = <0>;
	qcom,mdss-dsi-v-bottom-border = <0>;
	qcom,mdss-dsi-bpp = <24>;
	qcom,mdss-dsi-underflow-color = <0xff>;
	qcom,mdss-dsi-border-color = <0>;
	qcom,mdss-dsi-h-sync-pulse = <0>;
	qcom,mdss-dsi-traffic-mode = "burst_mode";
	qcom,mdss-dsi-bllp-eof-power-mode;
	qcom,mdss-dsi-bllp-power-mode;
	qcom,mdss-dsi-lane-map = "lane_map_0123";
	qcom,mdss-dsi-lane-0-state;
	qcom,mdss-dsi-lane-1-state;
	qcom,mdss-dsi-lane-2-state;
	qcom,mdss-dsi-lane-3-state;
	qcom,mdss-dsi-panel-timings = [87 1c 12 00 42 44 18 20 17 03 04 00];
	qcom,mdss-dsi-t-clk-post = <0x04>;
	qcom,mdss-dsi-t-clk-pre = <0x1b>;
	qcom,mdss-dsi-bl-min-level = <1>;
	qcom,mdss-dsi-bl-max-level = <4095>;
	qcom,mdss-dsi-dma-trigger = "trigger_sw";
	qcom,mdss-dsi-mdp-trigger = "none";

	qcom,mdss-dsi-on-command = [29 01 00 00 00 00 04 FF 98 81 03
29 01 00 00 00 00 02 01 00
29 01 00 00 00 00 02 02 00
29 01 00 00 00 00 02 03 53
29 01 00 00 00 00 02 04 14
29 01 00 00 00 00 02 05 00
29 01 00 00 00 00 02 06 06
29 01 00 00 00 00 02 07 01
29 01 00 00 00 00 02 08 00
29 01 00 00 00 00 02 09 01
29 01 00 00 00 00 02 0a 19
29 01 00 00 00 00 02 0b 01
29 01 00 00 00 00 02 0c 00
29 01 00 00 00 00 02 0d 00
29 01 00 00 00 00 02 0e 00
29 01 00 00 00 00 02 0f 19
29 01 00 00 00 00 02 10 19
29 01 00 00 00 00 02 11 00
29 01 00 00 00 00 02 12 00
29 01 00 00 00 00 02 13 00
29 01 00 00 00 00 02 14 00
29 01 00 00 00 00 02 15 04
29 01 00 00 00 00 02 16 04
29 01 00 00 00 00 02 17 00
29 01 00 00 00 00 02 18 00
29 01 00 00 00 00 02 19 00
29 01 00 00 00 00 02 1a 00
29 01 00 00 00 00 02 1b 00
29 01 00 00 00 00 02 1c 00
29 01 00 00 00 00 02 1d 00
29 01 00 00 00 00 02 1e 40
29 01 00 00 00 00 02 1f 40
29 01 00 00 00 00 02 20 02
29 01 00 00 00 00 02 21 05
29 01 00 00 00 00 02 22 02
29 01 00 00 00 00 02 23 00
29 01 00 00 00 00 02 24 87
29 01 00 00 00 00 02 25 87
29 01 00 00 00 00 02 26 00
29 01 00 00 00 00 02 27 00
29 01 00 00 00 00 02 28 3B
29 01 00 00 00 00 02 29 03
29 01 00 00 00 00 02 2a 00
29 01 00 00 00 00 02 2b 00
29 01 00 00 00 00 02 2c 00
29 01 00 00 00 00 02 2d 00
29 01 00 00 00 00 02 2e 00
29 01 00 00 00 00 02 2f 00
29 01 00 00 00 00 02 30 00
29 01 00 00 00 00 02 31 00
29 01 00 00 00 00 02 32 00
29 01 00 00 00 00 02 33 00
29 01 00 00 00 00 02 34 04
29 01 00 00 00 00 02 35 00
29 01 00 00 00 00 02 36 00
29 01 00 00 00 00 02 37 00
29 01 00 00 00 00 02 38 01
29 01 00 00 00 00 02 39 01
29 01 00 00 00 00 02 3a 40
29 01 00 00 00 00 02 3b 40
29 01 00 00 00 00 02 3c 00
29 01 00 00 00 00 02 3d 00
29 01 00 00 00 00 02 3e 00
29 01 00 00 00 00 02 3f 00
29 01 00 00 00 00 02 40 00
29 01 00 00 00 00 02 41 88
29 01 00 00 00 00 02 42 00
29 01 00 00 00 00 02 43 00
29 01 00 00 00 00 02 44 00
29 01 00 00 00 00 02 50 01
29 01 00 00 00 00 02 51 23
29 01 00 00 00 00 02 52 45
29 01 00 00 00 00 02 53 67
29 01 00 00 00 00 02 54 89
29 01 00 00 00 00 02 55 ab
29 01 00 00 00 00 02 56 01
29 01 00 00 00 00 02 57 23
29 01 00 00 00 00 02 58 45
29 01 00 00 00 00 02 59 67
29 01 00 00 00 00 02 5a 89
29 01 00 00 00 00 02 5b ab
29 01 00 00 00 00 02 5c cd
29 01 00 00 00 00 02 5d ef
29 01 00 00 00 00 02 5e 11
29 01 00 00 00 00 02 5f 08
29 01 00 00 00 00 02 60 00
29 01 00 00 00 00 02 61 01
29 01 00 00 00 00 02 62 02
29 01 00 00 00 00 02 63 02
29 01 00 00 00 00 02 64 0F
29 01 00 00 00 00 02 65 0D
29 01 00 00 00 00 02 66 0E
29 01 00 00 00 00 02 67 0C
29 01 00 00 00 00 02 68 02
29 01 00 00 00 00 02 69 02
29 01 00 00 00 00 02 6a 02
29 01 00 00 00 00 02 6b 02
29 01 00 00 00 00 02 6c 02
29 01 00 00 00 00 02 6d 02
29 01 00 00 00 00 02 6e 06
29 01 00 00 00 00 02 6f 02
29 01 00 00 00 00 02 70 02
29 01 00 00 00 00 02 71 02
29 01 00 00 00 00 02 72 02
29 01 00 00 00 00 02 73 02
29 01 00 00 00 00 02 74 02
29 01 00 00 00 00 02 75 06
29 01 00 00 00 00 02 76 00
29 01 00 00 00 00 02 77 01
29 01 00 00 00 00 02 78 02
29 01 00 00 00 00 02 79 02
29 01 00 00 00 00 02 7a 0F
29 01 00 00 00 00 02 7b 0D
29 01 00 00 00 00 02 7c 0E
29 01 00 00 00 00 02 7d 0C
29 01 00 00 00 00 02 7e 02
29 01 00 00 00 00 02 7f 02
29 01 00 00 00 00 02 80 02
29 01 00 00 00 00 02 81 02
29 01 00 00 00 00 02 82 02
29 01 00 00 00 00 02 83 02
29 01 00 00 00 00 02 84 08
29 01 00 00 00 00 02 85 02
29 01 00 00 00 00 02 86 02
29 01 00 00 00 00 02 87 02
29 01 00 00 00 00 02 88 02
29 01 00 00 00 00 02 89 02
29 01 00 00 00 00 02 8A 02
29 01 00 00 00 00 04 FF 98 81 04
29 01 00 00 00 00 02 0B 90
29 01 00 00 00 00 02 0E 0B
29 01 00 00 00 00 02 6C 15
29 01 00 00 00 00 02 6E 35
29 01 00 00 00 00 02 6F 45
29 01 00 00 00 00 02 8D 1A
29 01 00 00 00 00 02 3A 24
29 01 00 00 00 00 02 35 1F
29 01 00 00 00 00 02 33 00
29 01 00 00 00 00 02 7A 0F
29 01 00 00 00 00 02 87 BA
29 01 00 00 00 00 02 26 76
29 01 00 00 00 00 02 B2 D1
29 01 00 00 00 00 04 FF 98 81 01
29 01 00 00 00 00 02 22 09
29 01 00 00 00 00 02 53 78
29 01 00 00 00 00 02 55 8A
29 01 00 00 00 00 02 50 A7
29 01 00 00 00 00 02 51 A7
29 01 00 00 00 00 02 31 00
29 01 00 00 00 00 02 60 14
29 01 00 00 00 00 02 63 00
//29 01 00 00 00 00 02 42 33
29 01 00 00 00 00 02 A0 0F
29 01 00 00 00 00 02 A1 2E
29 01 00 00 00 00 02 A2 3e
29 01 00 00 00 00 02 A3 14
29 01 00 00 00 00 02 A4 14
29 01 00 00 00 00 02 A5 23
29 01 00 00 00 00 02 A6 18
29 01 00 00 00 00 02 A7 1F
29 01 00 00 00 00 02 A8 9A
29 01 00 00 00 00 02 A9 1D
29 01 00 00 00 00 02 AA 2D
29 01 00 00 00 00 02 AB 88
29 01 00 00 00 00 02 AC 1C
29 01 00 00 00 00 02 AD 18
29 01 00 00 00 00 02 AE 4C
29 01 00 00 00 00 02 AF 21
29 01 00 00 00 00 02 B0 2B
29 01 00 00 00 00 02 B1 58
29 01 00 00 00 00 02 B2 6E
29 01 00 00 00 00 02 B3 39
29 01 00 00 00 00 02 C0 00
29 01 00 00 00 00 02 C1 13
29 01 00 00 00 00 02 C2 20
29 01 00 00 00 00 02 C3 15
29 01 00 00 00 00 02 C4 18
29 01 00 00 00 00 02 C5 2E
29 01 00 00 00 00 02 C6 22
29 01 00 00 00 00 02 C7 1F
29 01 00 00 00 00 02 C8 93
29 01 00 00 00 00 02 C9 1C
29 01 00 00 00 00 02 CA 26
29 01 00 00 00 00 02 CB 88
29 01 00 00 00 00 02 CC 1B
29 01 00 00 00 00 02 CD 1B
29 01 00 00 00 00 02 CE 4D
29 01 00 00 00 00 02 CF 20
29 01 00 00 00 00 02 D0 24
29 01 00 00 00 00 02 D1 5A
29 01 00 00 00 00 02 D2 65
29 01 00 00 00 00 02 D3 39
29 01 00 00 00 00 04 FF 98 81 00
29 01 00 00 00 00 02 55 90
05 01 00 00 78 00 02 11 00
05 01 00 00 14 00 02 29 00
05 01 00 00 00 00 02 35 00];

	qcom,mdss-dsi-off-command = [05 01 00 00 14 00 02 28 00
				05 01 00 00 78 00 02 10 00];
	qcom,mdss-dsi-on-command-state = "dsi_lp_mode";
	qcom,mdss-dsi-off-command-state = "dsi_lp_mode";
	qcom,mdss-dsi-bl-pmic-control-type = "bl_ctrl_wled";
	qcom,mdss-dsi-reset-sequence = <1 20>, <0 20>, <1 120>;

	qcom,esd-check-enabled;
	qcom,mdss-dsi-panel-status-command      = [06 01 00 01 05 00 01 0A
		06 01 00 01 05 00 01 09];
	qcom,mdss-dsi-panel-status-command-mode = "dsi_lp_mode";
	qcom,mdss-dsi-panel-status-check-mode   = "reg_read";
	qcom,mdss-dsi-panel-status-read-length  = <1 3>;
	qcom,mdss-dsi-panel-status-valid-params = <1 3>;
	qcom,mdss-dsi-panel-status-value        = <0x9C 0x80 0x03 0x06>;
	qcom,mdss-dsi-panel-max-error-count     = <3>;

	//qcom,mdss-dsi-tx-eot-append;
	//qcom,mdss-dsi-post-init-delay = <8>;
	qcom,mdss-dsi-lp11-init;
	//qcom,mdss-dsi-init-delay-us = <50000>;
};
