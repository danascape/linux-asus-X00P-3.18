/*
 * Copyright (c) 2015-2018, The Linux Foundation. All rights reserved.
 *
 * This program is free software; you can redistribute it and/or modify
 * it under the terms of the GNU General Public License version 2 and
 * only version 2 as published by the Free Software Foundation.
 *
 * This program is distributed in the hope that it will be useful,
 * but WITHOUT ANY WARRANTY; without even the implied warranty of
 * MERCHANTABILITY or FITNESS FOR A PARTICULAR PURPOSE.  See the
 * GNU General Public License for more details.
 */

&apc_vreg_corner {
	qcom,cpr-virtual-corner-init-voltage-adjustment =
		<50000 50000 50000 50000 50000 75000 50000>,
		<50000 50000 50000 50000 50000 75000 50000>,
		<50000 50000 50000 50000 50000 75000 50000>,
		<50000 50000 50000 50000 50000 75000 50000>;

	qcom,cpr-virtual-corner-quotient-adjustment =
		<100 100 100 100 100 150 100>,
		<100 100 100 100 100 150 100>,
		<100 100 100 100 100 150 100>,
		<100 100 100 100 100 150 100>;
};
