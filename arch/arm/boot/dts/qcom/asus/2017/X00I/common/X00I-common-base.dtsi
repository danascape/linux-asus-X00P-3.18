/*
 * Copyright (c) 2015-2018, The Linux Foundation. All rights reserved.
 *
 * This program is free software; you can redistribute it and/or modify
 * it under the terms of the GNU General Public License version 2 and
 * only version 2 as published by the Free Software Foundation.
 *
 * This program is distributed in the hope that it will be useful,
 * but WITHOUT ANY WARRANTY; without even the implied warranty of
 * MERCHANTABILITY or FITNESS FOR A PARTICULAR PURPOSE.  See the
 * GNU General Public License for more details.
 */

/* X00I = msm89x7 */

#include "msm8937-mdss-panels.dtsi"
#include "msm-pm8937.dtsi"
#include "msm-pmi8950.dtsi"
#include "X00I.dtsi"
#include "X00I-audio.dtsi"
#include "X00I-camera-pinctrl.dtsi"
#include "X00I-camera-sensor-mtp.dtsi"
#include "X00I-mtp.dtsi"
#include "X00I-pinctrl.dtsi"
#include "X00I-pmi8950-mtp.dtsi"
