/*
 * Copyright (c) 2015-2018, The Linux Foundation. All rights reserved.
 *
 * This program is free software; you can redistribute it and/or modify
 * it under the terms of the GNU General Public License version 2 and
 * only version 2 as published by the Free Software Foundation.
 *
 * This program is distributed in the hope that it will be useful,
 * but WITHOUT ANY WARRANTY; without even the implied warranty of
 * MERCHANTABILITY or FITNESS FOR A PARTICULAR PURPOSE.  See the
 * GNU General Public License for more details.
 */

&mdss_mdp {
	/delete-node/ qcom,mdss_dsi_hx8394f_720p_video;

	#include "display/dsi-panel-hx8394f-720p-video.dtsi"
	#include "display/dsi-panel-ili9885-fhd-video-dj.dtsi"
	#include "display/dsi-panel-ili9881c-fhd-video-dj.dtsi"
};
