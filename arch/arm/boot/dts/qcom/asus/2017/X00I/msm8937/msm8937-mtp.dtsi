/*
 * Copyright (c) 2015-2018, The Linux Foundation. All rights reserved.
 *
 * This program is free software; you can redistribute it and/or modify
 * it under the terms of the GNU General Public License version 2 and
 * only version 2 as published by the Free Software Foundation.
 *
 * This program is distributed in the hope that it will be useful,
 * but WITHOUT ANY WARRANTY; without even the implied warranty of
 * MERCHANTABILITY or FITNESS FOR A PARTICULAR PURPOSE.  See the
 * GNU General Public License for more details.
 */

&soc {
	focal_fp {
		vdd-supply = <&pm8937_l10>;
	};
};

&mdss_dsi0 {
	qcom,dsi-pref-prim-pan = <&dsi_ili9885_fhd_vid>;
	qcom,platform-vsn-gpio = <&tlmm 45 0>;
	qcom,platform-vsp-gpio = <&tlmm 46 0>;
};
