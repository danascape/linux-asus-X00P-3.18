
qcom,3340624_wind_e300cos_4000mah_averaged_masterslave_feb20th2018 {
	/* #3340624_Wind_E300cos_4000mAh_averaged_MasterSlave_Feb20th2018*/
	qcom,max-voltage-uv = <4350000>;
	qcom,nom-batt-capacity-mah = <4000>;
	qcom,batt-id-kohm = <51>;
	qcom,battery-beta = <3435>;
	qcom,thermal-coefficients=[C8 86 C1 50 D3 37];    /*liulinsheng@wind-mobi.com */
	qcom,battery-type = "3340624_wind_e300cos_4000mah_averaged_masterslave_feb20th2018";
	qcom,chg-rslow-comp-c1 = <4155423>;
	qcom,chg-rslow-comp-c2 = <7654994>;
	qcom,chg-rs-to-rslow = <894067>;
	qcom,chg-rslow-comp-thr = <0xBA>;
	qcom,checksum = <0x335B>;
	qcom,gui-version = "PMI8950GUI - 2.0.0.16";
	qcom,fg-profile-data = [
		 D3 83 DE 77 
		 FC 7B B7 74 
		 38 83 64 73 
		 02 84 6C 80 
		 EF 81 4B 9B 
		 7C BE E1 CB 
		 7A 11 0C 88 
		 EC 7D 6E 81 
		 83 77 39 83 
		 01 79 15 86 
		 36 82 27 82 
		 2A 9B 5A BF 
		 34 D1 79 0F 
		 F1 0E 87 5A 
		 CE 6E 0B FE 
		 55 20 EA 44 
		 54 22 00 00 
		 17 4D A7 3A 
		 93 41 00 00 
		 00 00 00 00 
		 00 00 00 00 
		 B6 70 DD 6A 
		 8D 8F 3B 75 
		 DC 7D 91 73 
		 A4 74 9C 78 
		 20 7C BE 70 
		 F1 64 9F 9A 
		 39 25 5A 94 
		 57 A0 71 0C 
		 28 00 FF 36 
		 F0 11 30 03 
		 00 00 00 0C 
	];
};
